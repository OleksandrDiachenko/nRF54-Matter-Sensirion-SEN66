## tests/air_quality_endpoint/testcase.yaml
```yaml
tests:
  air_quality_endpoint.policy:
    tags: air_quality_endpoint
    type: unit
```

## tests/measurement_service/testcase.yaml
```yaml
tests:
  measurement_service.policy:
    tags: measurement_service
    type: unit
```
